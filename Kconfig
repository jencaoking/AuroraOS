## Kconfig
```kconfig
mainmenu "auroraOS Configuration"

choice
    prompt "Target Hardware Board"
    default BOARD_LM3S6965_QB
    help
      Select the hardware target board for auroraOS.

config BOARD_LM3S6965_QB
    bool "TI LM3S6965-QB (QEMU Cortex-M3)"

config BOARD_MIBAND8
    bool "Xiaomi Mi Band 8 (Ambiq Apollo3 Cortex-M4F)"

config BOARD_QEMU_RV32_VIRT
    bool "QEMU RISC-V 32 Virt (RV32IMAC)"

endchoice

config BOARD
    string
    default "lm3s6965-qb" if BOARD_LM3S6965_QB
    default "miband8" if BOARD_MIBAND8
    default "qemu_rv32_virt" if BOARD_QEMU_RV32_VIRT

menu "System Core Configuration"

config SCHEDULER
    bool "Enable Task Scheduler"
    default y
    help
      Enable the preemptive priority-based task scheduler.

config MAX_TASKS
    int "Maximum number of tasks"
    default 8 if BOARD_MIBAND8
    default 16
    help
      The maximum number of tasks the scheduler can manage.

config TICK_RATE_HZ
    int "System Tick Rate (Hz)"
    default 1000
    help
      The frequency of the system tick interrupt in Hz.

config NO_DYNAMIC_ALLOCATION
    bool "Disable Dynamic Memory Allocation"
    default y
    help
      If enabled, all new/malloc calls will trigger a panic. Enforces static memory allocation.

endmenu

menu "File Systems"

config VFS
    bool "Virtual File System (VFS)"
    default y
    help
      Enable the Virtual File System layer.

config FS_RAMFS
    bool "RAM File System (RamFS)"
    depends on VFS
    default y
    help
      Enable the RamFS.

config FS_PROCFS
    bool "Process File System (ProcFS)"
    depends on VFS
    default y
    help
      Enable the ProcFS for system information.

endmenu

menu "Device Drivers"

config DEVICE_UART
    bool "UART Driver"
    default y
    help
      Enable UART character device driver.

config TIMER_MANAGER
    bool "Software Timer Manager"
    default y
    help
      Enable the software timer daemon.

config WORK_QUEUE
    bool "Work Queue"
    default y
    help
      Enable the background work queue for deferring ISR work.

endmenu

menu "Networking"

config NETWORKING
    bool "Networking Support"
    default n if BOARD_MIBAND8
    default y
    help
      Enable networking subsystem.

config NET_LWIP
    bool "LwIP Stack"
    depends on NETWORKING
    default y
    help
      Enable the LwIP network stack.

config NET_DEFAULT_IP
    string "Default IP Address"
    depends on NET_LWIP
    default "10.0.2.15"

config NET_DEFAULT_MAC
    string "Default MAC Address"
    depends on NET_LWIP
    default "00:11:22:33:44:55"

endmenu

menu "Applications and runtimes"

config LUA_VM
    bool "Lua 5.4.6 Virtual Machine"
    default y if BOARD_MIBAND8
    default n
    help
      Enable the Lua scripting engine.
      WARNING: Lua 5.4.6 requires significant memory. It is highly recommended to disable this on targets with < 128KB SRAM (e.g. LM3S6965) to avoid OOM crashes.

endmenu

source "Kconfig.miband"
```
